## conf/layer.conf
```bitbake
# We have a conf and classes directory, add to BBPATH
BBPATH .= ":${LAYERDIR}"

# We have recipes-* directories, add to BBFILES
BBFILES += "${LAYERDIR}/recipes-*/*/*.bb \
            ${LAYERDIR}/recipes-*/*/*.bbappend"

BBFILE_COLLECTIONS += "meta-venom-imx"
BBFILE_PATTERN_meta-venom-imx = "^${LAYERDIR}/"
BBFILE_PRIORITY_meta-venom-imx = "6"

LAYERDEPENDS_meta-venom-imx = "core"
LAYERSERIES_COMPAT_meta-venom-imx = "scarthgap"
#LAYERSERIES_COMPAT_meta-venom = "gatesgarth honister kirkstone"
```
